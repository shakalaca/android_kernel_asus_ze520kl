## drivers/sensors/Kconfig
```kconfig
config SENSORS
	bool "Sensors Class Support"
	help
	  This option enables the sensor sysfs class in /sys/class/sensors.
	  You'll need this to do anything useful with sensors. If unsure, say N.

config SENSORS_SSC
	bool "Enable Sensors Driver Support for SSC"
	help
	  Add support for sensors SSC driver.
	  This driver is used for exercising sensors use case,
	  time syncing with ADSP clock.

config INPUT_CM3323E
	tristate "CM3323E RGB color sensor"
	depends on I2C
	help
	  Say Y here to enable the CM3323E RGB Color Sensor.

config SYNAPTICS_SPIDRV
	tristate "FingerPrint sensor"
	depends on SPI_MASTER
	help
	  add for support FP Sensor.
```
