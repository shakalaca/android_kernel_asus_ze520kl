/* Copyright (c) 2013, The Linux Foundation. All rights reserved.
 *
 * This program is free software; you can redistribute it and/or modify
 * it under the terms of the GNU General Public License version 2 and
 * only version 2 as published by the Free Software Foundation.
 *
 * This program is distributed in the hope that it will be useful,
 * but WITHOUT ANY WARRANTY; without even the implied warranty of
 * MERCHANTABILITY or FITNESS FOR A PARTICULAR PURPOSE.  See the
 * GNU General Public License for more details.
 */

/*---------------------------------------------------------------------------
 * This file is autogenerated file using gcdb parser. Please do not edit it.
 * Update input XML file to add a new entry or update variable in this file
 * VERSION = "1.0"
 *---------------------------------------------------------------------------*/
&mdss_mdp {
	dsi_ctc5p5_ili7807b_1080p_video: qcom,mdss_dsi_ctc5p5_ili7807b_1080p_video {
		qcom,mdss-dsi-panel-name = "ctc5p5 ili7807b 1080p video mode dsi panel";
		qcom,mdss-dsi-panel-controller = <&mdss_dsi0>;
		qcom,ulps-enabled;
		qcom,suspend-ulps-enabled;
		qcom,mdss-dsi-panel-type = "dsi_video_mode";
		qcom,mdss-dsi-panel-destination = "display_1";
		qcom,mdss-dsi-panel-framerate = <60>;
		qcom,mdss-dsi-virtual-channel-id = <0>;
		qcom,mdss-dsi-stream = <0>;
		qcom,mdss-dsi-panel-width = <1080>;
		qcom,mdss-dsi-panel-height = <1920>;
		qcom,mdss-dsi-h-front-porch = <120>;
		qcom,mdss-dsi-h-back-porch = <80>;
		qcom,mdss-dsi-h-pulse-width = <6>;
		qcom,mdss-dsi-h-sync-skew = <0>;
		qcom,mdss-dsi-v-back-porch = <8>;
		qcom,mdss-dsi-v-front-porch = <8>;
		qcom,mdss-dsi-v-pulse-width = <6>;
		qcom,mdss-dsi-h-left-border = <0>;
		qcom,mdss-dsi-h-right-border = <0>;
		qcom,mdss-dsi-v-top-border = <0>;
		qcom,mdss-dsi-v-bottom-border = <0>;
		qcom,mdss-dsi-bpp = <24>;
		qcom,mdss-dsi-color-order = "rgb_swap_rgb";
		qcom,mdss-dsi-underflow-color = <0xff>;
		qcom,mdss-dsi-border-color = <0>;
                qcom,mdss-dsi-on-command = [39 01 00 00 00 00 04 FF 78 07 05
                        39 01 00 00 00 00 02 03 EE
                        39 01 00 00 00 00 02 04 16
                        39 01 00 00 00 00 02 05 11
                        39 01 00 00 00 00 02 00 FB
                        39 01 00 00 00 00 02 01 3F
                        39 01 00 00 00 00 02 02 54
                        39 01 00 00 00 00 02 08 30
                        39 01 00 00 00 00 02 10 3E
                        39 01 00 00 00 00 02 12 3D
                        39 01 00 00 00 00 02 13 3C
                        39 01 00 00 00 00 02 14 39
                        39 01 00 00 00 00 02 16 38
                        39 01 00 00 00 00 02 1C FE
                        39 01 00 00 00 00 02 1D 3D
                        39 01 00 00 00 00 02 1E FC
                        39 01 00 00 00 00 02 1F 3A
                        39 01 00 00 00 00 02 20 3A
                        39 01 00 00 00 00 02 21 B4
                        39 01 00 00 00 00 02 22 F0
                        39 01 00 00 00 00 02 23 EE
                        39 01 00 00 00 00 02 24 FE
                        39 01 00 00 00 00 02 25 3E
                        39 01 00 00 00 00 02 26 FD
                        39 01 00 00 00 00 02 06 20
                        39 01 00 00 00 00 02 07 00
                        39 01 00 00 00 00 04 FF 00 00 00
                        15 01 00 00 00 00 02 53 24
                        39 01 00 00 00 00 03 68 04 01
                        39 01 00 00 00 00 03 51 00 00
                        39 01 00 00 00 00 03 5E 00 a4
                        05 01 00 00 78 00 02 11 00
                        05 01 00 00 00 00 02 29 00];
		qcom,mdss-dsi-off-command = [05 01 00 00 3C 00 02 28 00
			 05 01 00 00 78 00 02 10 00];
		qcom,mdss-dsi-on-command-state = "dsi_lp_mode";
		qcom,mdss-dsi-off-command-state = "dsi_lp_mode";
		qcom,mdss-dsi-h-sync-pulse = <1>;
		qcom,mdss-dsi-traffic-mode = "burst_mode";
		qcom,mdss-dsi-lane-map = "lane_map_0123";
		qcom,mdss-dsi-bllp-eof-power-mode;
		qcom,mdss-dsi-bllp-power-mode;
		qcom,mdss-dsi-lane-0-state;
		qcom,mdss-dsi-lane-1-state;
		qcom,mdss-dsi-lane-2-state;
		qcom,mdss-dsi-lane-3-state;
		qcom,mdss-dsi-panel-timings = [e7 36 24 00 66 6a 2a 3a 2d 03 04 00];
		qcom,mdss-dsi-t-clk-post = <0x03>;
		qcom,mdss-dsi-t-clk-pre = <0x2b>;
		qcom,mdss-dsi-bl-min-level = <8>;
		qcom,mdss-dsi-bl-max-level = <1023>;
		qcom,mdss-dsi-dma-trigger = "trigger_sw";
		qcom,mdss-dsi-mdp-trigger = "none";
		qcom,mdss-dsi-bl-pmic-control-type = "bl_ctrl_dcs";
		qcom,mdss-dsi-reset-sequence = <1 10>, <0 1>, <1 10>;
		qcom,mdss-pan-physical-width-dimension = <68>; //width of picture in mm (for xdpi)
		qcom,mdss-pan-physical-height-dimension = <121>; //height of picture in mm (for ydpi)
		qcom,mdss-dsi-lp11-init;
		qcom,mdss-dsi-init-delay-us = <5000>;
	};
};
