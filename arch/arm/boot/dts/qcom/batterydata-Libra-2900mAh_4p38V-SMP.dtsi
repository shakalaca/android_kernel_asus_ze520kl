
qcom,Libra_2900mah_4p38v_SMP {
	/* #Libra_2900mah_4p38v_SMP*/
	qcom,max-voltage-uv = <4380000>;
	qcom,nom-batt-capacity-mah = <2900>;
	qcom,batt-id-kohm = <51>;
	qcom,battery-beta = <3435>;
	qcom,battery-type = "Libra_2900mah_4p38v_SMP";
	qcom,chg-rslow-comp-c1 = <3105417>;
	qcom,chg-rslow-comp-c2 = <3966341>;
	qcom,chg-rs-to-rslow = <1617694>;
	qcom,chg-rslow-comp-thr = <0x9C>;
	qcom,checksum = <0x85AA>;
	qcom,gui-version = "PMI8950GUI - 2.0.0.16";
	qcom,fg-profile-data = [
		 B9 83 C3 75 
		 3F 7A F6 6D 
		 61 83 26 6F 
		 EB 88 26 94 
		 4D 82 31 98 
		 7A B5 CC C0 
		 55 19 65 83 
		 0B 3D 77 71 
		 D1 55 3A 83 
		 A5 78 A4 84 
		 EB 7A 73 82 
		 1F 98 18 B6 
		 1F C2 71 16 
		 36 0B BE 59 
		 91 6F 9A F9 
		 54 2C ED 3E 
		 AE 35 00 00 
		 AE 2A 12 3B 
		 4C 4D 00 00 
		 00 00 00 00 
		 00 00 00 00 
		 31 72 2D 71 
		 44 5E 54 81 
		 B3 74 D6 60 
		 E5 62 86 7B 
		 A7 6F 2D 59 
		 B9 58 32 A8 
		 20 14 68 55 
		 65 A0 71 0C 
		 28 00 FF 36 
		 F0 11 30 03 
		 00 00 00 0C 
	];
};
