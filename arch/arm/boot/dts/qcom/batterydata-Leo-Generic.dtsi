
qcom,batterydata_Leo_Generic {
	/* #batterydata_Leo_Generic*/
	qcom,max-voltage-uv = <4380000>;
	qcom,nom-batt-capacity-mah = <2530>;
	qcom,batt-id-kohm = <51>;
	qcom,battery-beta = <3435>;
	qcom,battery-type = "batterydata_Generic";
	qcom,chg-rslow-comp-c1 = <3264924>;
	qcom,chg-rslow-comp-c2 = <4924951>;
	qcom,chg-rs-to-rslow = <1159568>;
	qcom,chg-rslow-comp-thr = <0xAB>;
	qcom,checksum = <0x6CE1>;
	qcom,gui-version = "PMI8950GUI - 2.0.0.15";
	qcom,fg-profile-data = [
		 ED 83 36 7D 
		 44 81 8F 77 
		 5F 83 41 6D 
		 05 88 69 8E 
		 2B 82 65 99 
		 13 BC 25 C8 
		 5B 0F FF 83 
		 60 7D 44 81 
		 66 77 57 83 
		 30 68 1E 7B 
		 F3 87 56 82 
		 87 99 D6 BC 
		 B9 C9 59 0D 
		 E7 09 13 5A 
		 91 6F EE FC 
		 3C 3E 3A 44 
		 7B 40 00 00 
		 1E 45 32 15 
		 00 00 00 00 
		 00 00 00 00 
		 00 00 00 00 
		 0D 71 2B 70 
		 08 69 0C 88 
		 90 74 C2 63 
		 03 5C 86 79 
		 DC 6E 58 60 
		 CA 6D CB A9 
		 1B 90 68 8B 
		 66 A0 71 0C 
		 28 00 FF 36 
		 F0 11 30 03 
		 00 00 00 0C 
	];
};
